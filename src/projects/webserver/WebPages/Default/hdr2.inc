</head>

<body>
<div id="shadow-one"><div id="shadow-two"><div id="shadow-three"><div id="shadow-four">
<div id="page">

<div style="padding:0 0 5px 5px"><img src="/mchp.gif" alt="Microchip" /></div>

<div id="title"><div class="right">TCP/IP Stack Demo Application</div><span id="hello">&nbsp;</span></div>

<div id="menu">
<a href="/index.htm">Overview</a>
<a href="/power.htm">Power Page</a>
<a href="/dynvars.htm">Dynamic Variables</a>
<a href="/ajax.htm">AJAX and jQuery</a>
<a href="/forms.htm">Form Processing</a>
<a href="/auth.htm">Authentication</a>
<a href="/cookies.htm">Cookies</a>
<a href="/uploadfile.htm">File Uploads</a>
<a href="/email">Send E-mail</a>
<a href="/dyndns">Dynamic DNS</a>
<a href="/protect/config.htm">Network Configuration</a>
<a href="/snmp/snmpconfig.htm">SNMP Configuration</a>
<a href="/upload.htm">Upload Firmware and Web Pages</a>
</div>